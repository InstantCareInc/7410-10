## bmp585/zephyr/Kconfig
```kconfig
menu "BMP585 Module Configuration"

# This line includes the Kconfig file for the sensor directory
source "drivers/sensor/Kconfig" 

endmenu
```

## bmp585/zephyr/dts/bindings/sensor/bosch,bmp585-spi.yaml
```yaml
# Copyright (c) 2025 Bosch Sensortec GmbH. All rights reserved.
# SPDX-License-Identifier: Apache-2.0

description: |
    Bosch BMP388 pressure sensor accessed through SPI bus

compatible: "bosch,bmp585"

include: [spi-device.yaml, "bosch,bmp585.yaml"]
```

## boards/InstantCare/PCB7410_10_006/PCB7410_10_006_defconfig
```kconfig
# CPU and safety
CONFIG_ARM_MPU=y
CONFIG_HW_STACK_PROTECTION=y

# Clock and timing
CONFIG_CLOCK_CONTROL=y
# external clock not working
# CONFIG_CLOCK_CONTROL_NRF_K32SRC_XTAL=y

CONFIG_CLOCK_CONTROL_NRF_K32SRC_RC=y
CONFIG_CLOCK_CONTROL_NRF_K32SRC_RC_CALIBRATION=y

# Console defaults
CONFIG_CONSOLE=y
CONFIG_UART_CONSOLE=y

# Basic kernel features
CONFIG_MAIN_STACK_SIZE=2048
CONFIG_IDLE_STACK_SIZE=256
```

## boards/InstantCare/PCB7410_10_006/board.yml
```yaml
board:
  name: PCB7410_10_006
  vendor: InstantCare
  socs:
    - name: nrf52832
```

## drivers/sensor/bmp585/Kconfig
```kconfig
# Copyright (c) 2020 Facebook, Inc. and its affiliates
# SPDX-License-Identifier: Apache-2.0

menuconfig BMP585
	bool "Bosch BMP585 pressure sensor"
	default y
	depends on DT_HAS_BOSCH_BMP585_ENABLED
	select I2C if $(dt_compat_on_bus,$(DT_COMPAT_BOSCH_BMP585),i2c)
	select SPI if $(dt_compat_on_bus,$(DT_COMPAT_BOSCH_BMP585),spi)
	help
	  Enable driver for the Bosch BMP585 pressure sensor

if BMP585

config BMP585_TRIGGER
	bool "Use IRQ handler"
endif # BMP585
```
